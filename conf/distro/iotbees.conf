## conf/distro/iotbees.conf
```bitbake
# IoT Bees distro definition
require conf/distro/poky.conf

DISTRO = "iotbees"
DISTRO_NAME = "IoT Bees"
DISTRO_VERSION = "0.1.0"
MAINTAINER = "IoT Bees <prasanth.iot@gmail.com>"

DISTRO_FEATURES:append = " systemd bluetooth wifi usrmerge"
VIRTUAL-RUNTIME_init_manager = "systemd"

COPY_LIC_MANIFEST = "1"
COPY_LIC_DIRS = "1"
```

## conf/layer.conf
```bitbake
# IoT Bees Yocto layer
BBPATH .= ":${LAYERDIR}"
BBFILES += "${LAYERDIR}/recipes-*/*/*.bb ${LAYERDIR}/recipes-*/*/*.bbappend"

BBFILE_COLLECTIONS += "meta-iotbees"
BBFILE_PATTERN_meta-iotbees = "^${LAYERDIR}/"
BBFILE_PRIORITY_meta-iotbees = "10"

LAYERDEPENDS_meta-iotbees = "core"
LAYERSERIES_COMPAT_meta-iotbees = "scarthgap"
```
